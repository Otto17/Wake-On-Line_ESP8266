//********** ФУНКЦИЯ LOOP **********//


void loop() {
  led_State = digitalRead(PWR_LED);  // Считываем состояние Power LED в "led_State"

  ui.tick();         // Тикер WEB UI (для опроса и обработки всех функций библиотеки)
  ButtSwRes.tick();  // Тикер для обработчика кнопки (нужен для того, чтобы корректно считались все таймауты)

  TEMP();           // Функция опроса и получения температуры с датчика DS18B20
  Timer_Power();    // Функция проверки работы таймеров для управления состоянием оптопары управления ПК
  controlButton();  // Постоянно проверяем функцию обработчика кнопки на нажатия или удержание


#if (ENABLE_REMOTEXY == 1)  // Выполняется, если включено управление через RemoteXY

  //Функции отвечающие за обмен данными сприложением RemoteXY
  RemoteXY_Handler();  // Обработчик библиотеки RemoteXY (должен всегда опрашиваться в Loop)
  PowerState_XY();     // Функция проверки состояния ПК (Power LED)
  PowerControl_XY();   // Функция для управления ПК (Вкл./Выкл./жёсткое выкл. PC)
  Temperature_XY();    // Функция для отправки температуры

#endif

  //Условия проверки подачи питания на оптопару (Вкл./Выкл./жёсткое выкл. PC)
  switch (StateOptron) {             // Проверяем переменную на данные
    case 1:                          // Если в неё 1, то Вкл./Выкл. PC (имитация короткого нажатия кнопки Power на PC)
      digitalWrite(INDICATOR, LOW);  // Включаем LED индикатор
      digitalWrite(PWR_SW, HIGH);    // Подаём питание на отпопару
      break;                         // Выходим из case

    case 2:                          // Если в неё 2, то принудительное Выкл. PC (имитация долгого нажатия кнопки Power на PC)
      digitalWrite(INDICATOR, LOW);  // Включаем LED индикатор
      digitalWrite(PWR_SW, HIGH);    // Подаём питание на отпопару
      break;

    default:                          // Если в неё любые другие цифры, то всё выключаем
      digitalWrite(INDICATOR, HIGH);  // Выключаем LED индикатор
      digitalWrite(PWR_SW, LOW);      // Убираем питание с отпопары
      break;
  }


  //Проверка состояния Power LED
  if (led_State == true) {  // Если флаг поднят...
    ButState = ButOff;      // LED индикатор состояния ПК горит, то показываем надпись на кнопке "Выключить"
    PowerState = StateOn;   // LED горит, то показываем надпись ON рядом с состоянием ПК
    ColorTitle = GP_GREEN;  // LED горит, то надпись ON красим в зелёный
  }

  if (led_State == false) {  // Если флаг опущен...
    ButState = ButOn;        // LED индикатор состояния ПК НЕ горит, то показываем надпись на кнопке "Включить"
    PowerState = StateOff;   // LED не горит, то показываем надпись OFF рядом с состоянием ПК
    ColorTitle = GP_RED;     // LED горит, то надпись OFF красим в красный
  }

  //Если флаг поднят, то моргаем LED индикатором на модуле ESP8266 раз в 40 мс (без задержки кода).
  if (flagRes == true) digitalWrite(INDICATOR, (millis() / 40) % 2);  // Позволяет визуально определить когда можно отпускать кнопку для сброса настроек
}