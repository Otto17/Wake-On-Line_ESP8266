//********** ФУНКЦИИ ПРИ НАЖАТИИ КНОПКИ НА ПЛАТЕ ESP И С WEB **********//


//Функция проверки работы таймеров для управления состоянием оптопары
void Timer_Power() {
  //Таймер для Вкл./Выкл. ПК
  if (tmr_OnOff.tick() == true) {       // Если таймер "tmr_OnOff" запущен/перезапущен (пришла команда с физ. или WEB кнопки), то...
    if (tmr_OnOff.active() == false) {  // Проверяем работает ли таймер (start/resume), если НЕ работает, то...
      StateOptron = 0;                  // Присваеваем цифру 0 - (Выключаем всё) для проверки switch case
      tmr_OnOff.stop();                 // Останавливаем таймер
    }
  }

  //Таймер для Reset(Off) ПК
  if (tmr_Reset.tick() == true) {       // Если таймер режима "tmr_Reset" запущен/перезапущен (пришла команда с физ. или WEB кнопки), то...
    if (tmr_Reset.active() == false) {  // Проверяем работает ли таймер (start/resume), если НЕ работает, то...
      StateOptron = 0;                  // Присваеваем цифру 0 - (Выключаем всё) для проверки switch case
      tmr_Reset.stop();                 // Останавливаем таймер
    }
  }
}



//Функция обработчика физической кнопки
void controlButton() {
  //Одинарное нажатие кнопки "PIN_BUT" - эмитация короткого нажатия кнопки Power на ПК (Вкл./Выкл)
  if (ButtSwRes.hasClicks(1)) {  // Если получаем 1 клик с кнопки
    StateOptron = 1;             // Присваеваем цифру 1 - On/Off для проверки switch case
    tmr_OnOff.start();           // Запускаем таймер для On/Off
  }

  //Тройное нажатие кнопки "PIN_BUT" - эмитация долгого удержания кнопки Power на ПК (Reset)
  if (ButtSwRes.hasClicks(3)) {  // Если получаем 3 клика с кнопки
    StateOptron = 2;             // Присваеваем цифру 2 - Reset (Off) для проверки switch case
    tmr_Reset.start();           // Запускаем таймер для Reset (Off)
  }

  // Долгое удержание кнопки "BUTTON_SW_RES" (Сброс настроек WiFiManager и перезагрузка ESP8266 в режим AP)
  if (ButtSwRes.step()) {  // Если кнопка удерживается заданное время в " ButtSw.setHoldTimeout()", то быстро мыргаем LED
    flagRes = true;        // Поднимаем флаг
  }

  //Долгое удержание кнопки "PIN_BUT" на время "SET_HOLD_TIMEOUT" и отпускание её
  if (ButtSwRes.releaseStep()) {  // Как только отпустили кнопку после долгого удержания

#if (ENABLE_REMOTEXY == 1)  // Выполняется, если включено форматирование FS

    LittleFS.format();  // Форматируем файловую систему (тем самым стираем все файлы из FS)
    delay(2000);        // Ждём корректного стирания

#endif

    flagRes = false;  // Опускаем флаг
    for (byte rw = 0; rw < EEPROM_BEGIN; rw++) {
      EEPROM.write(rw, 0);  // Подготавливаем к записи нулей с 0 по "EEPROM_BEGIN" ячейки (сохраняем в ОЗУ)
      EEPROM.commit();      // Записываем из ОЗУ в EEPROM
      EEPROM.end();         // И очищаем данные из ОЗУ
    }
    ESP.restart();  // Перезагружаем ESP
    delay(2000);    // Ждём для корректной перезагрузки
  }
}