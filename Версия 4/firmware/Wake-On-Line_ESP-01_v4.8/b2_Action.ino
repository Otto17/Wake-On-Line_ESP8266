//********** ДЕЙСТВИЯ ОТ КОНСТРУКТОРА САЙТА **********//



//Функция с действиями от WEB интерфейса
void action() {

  //Условия проверкина нажатия и отпускания WEB кнопок
  if (ui.hold()) {  // Вернёт true, если статус удержания кнопки изменился (нажата/отпущена)

    //Вкл./Выкл. ПК
    if (ui.clickUp("pwr_sw")) {  // Вернёт true, если кнопка (Вкл./Выкл.) была нажата и отпущена
      StateOptron = 1;           // Присваеваем цифру 1 - On/Off для проверки switch case
      tmr_OnOff.start();         // Запускаем таймер для On/Off
    }
  }



  //Если одна из форм была submit...
  if (ui.form()) {

    //Проверка и обработка данных с формы для WiFi
    if (ui.form("/ssid_pass")) {                   // Проверяем, была ли это форма "/ssid_pass"
      ui.copyStr("ssid_WiFi_UI", portalCfg.ssid);  // Получаем SSID WiFi с формы и присаиваем переменным
      ui.copyStr("pass_WiFi_UI", portalCfg.pass);  // Получаем Пароль WiFi с формы и присаиваем переменным

      EEPROM.begin(EEPROM_BEGIN);  // Инициализируем EEPROM
      EEPROM.put(0, portalCfg);    // Подготавливаем структуру к записи с нулевой ячейки (сохраняем её в ОЗУ)
      EEPROM.commit();             // Записываем из ОЗУ в EEPROM
      EEPROM.end();                // И очищаем данные из ОЗУ

      ESP.restart();  // Перезагружаем ESP
      delay(2000);    // Ждём для корректной перезагрузки
    }


    //Проверка и обработка данных с формы для авторизации на WEB интерфейсе
    if (ui.form("/log_pass")) {                // Проверяем, была ли это форма "/log_pass"
      ui.copyStr("lg_UI", portalCfg.loginUI);  // Получаем Логин UI с формы и присаиваем переменным
      ui.copyStr("ps_UI", portalCfg.passUI);   // Получаем Пароль UI с формы и присаиваем переменным

      EEPROM.begin(EEPROM_BEGIN);  // Инициализируем EEPROM
      EEPROM.put(0, portalCfg);    // Подготавливаем структуру к записи с нулевой ячейки (сохраняем её в ОЗУ)
      EEPROM.commit();             // Записываем из ОЗУ в EEPROM
      EEPROM.end();                // И очищаем данные из ОЗУ
    }
  }



  //Условия проверки нажатия кнопкок на обновление
  if (ui.update()) {  // Проверка на update, вернёт true, если было обновление

    //Проверка на обновление - Reset ПК
    //Вызов обновления с WEB кнопки "Reset (Off)". Нужно для вывода информирования с подтверждением, при случайном нажатии кнопки
    if (ui.update("inf_pwr_res")) {  // Если было обновление с компонента "inf_pwr_res", то
      ui.answer(1);                  // Отправляем в ответ на обновление число 1
    }

    //Проверка на обновление - Перезагрузка ESP
    //Вызов обновления с WEB кнопки "Перезагрузить ESP". Нужно для вывода информирования с подтверждением, при случайном нажатии кнопки
    if (ui.update("inf_rebootESP")) {  // Если было обновление с компонента "inf_rebootESP", то
      ui.answer(1);                    // Отправляем в ответ на обновление число 1
    }

    //Проверка на обновление - Сброс настроек ESP
    //Вызов обновления с WEB кнопки "Сброс настроек ESP". Нужно для вывода информирования с подтверждением, при случайном нажатии кнопки
    if (ui.update("inf_resetESP")) {  // Если было обновление с компонента "inf_resetESP", то
      ui.answer(1);                   // Отправляем в ответ на обновление число 1
    }
  }



  //Reset (Off) ПК
  if (ui.click()) {  // Проверка кнопок на клики

    //Выполняем действие после нажатия "ДА" на информ. окне - Reset (Off)
    if (ui.click("inf_pwr_res")) {              // Вернёт true, если был клик по кнопке информационного окошка "inf_pwr_res"
      if (ui.getBool("inf_pwr_res") == true) {  //tmr_Reset = millis();
        StateOptron = 2;                        // Присваеваем цифру 2 - Reset (Off) для проверки switch case
        tmr_Reset.start();                      // Запускаем таймер для Reset (Off)
      }
    }

    //Выполняем действие после нажатия "ДА" на информ. окне - Перезагрузка ESP
    if (ui.click("inf_rebootESP")) {              // Вернёт true, если был клик по кнопке информационного окошка "inf_rebootESP"
      if (ui.getBool("inf_rebootESP") == true) {  // Получаем состояние "inf_rebootESP" (если нажато на WEB информировании да - true, нет - false)
        ESP.restart();                            // Перезагружаем ESP
        delay(2000);                              // Ждём для корректной перезагрузки
      }
    }

    //Выполняем действие после нажатия "ДА" на информ. окне - Сброс настроек ESP
    if (ui.click("inf_resetESP")) {              // Вернёт true, если был клик по кнопке информационного окошка "inf_resetESP"
      if (ui.getBool("inf_resetESP") == true) {  // Получаем состояние "inf_resetESP" (если нажато на WEB информировании да - true, нет - false)

#if (ENABLE_REMOTEXY == 1)  // Выполняется, если включено форматирование FS

        LittleFS.format();  // Форматируем файловую систему (тем самым стираем все файлы из FS)
        delay(2000);        // Ждём корректного стирания

#endif

        EEPROM.begin(EEPROM_BEGIN);  // Инициализируем EEPROM
        for (byte rw = 0; rw < EEPROM_BEGIN; rw++) {
          EEPROM.write(rw, 0);  // Подготавливаем к записи нулей с 0 по "EEPROM_BEGIN" ячейки (сохраняем в ОЗУ)
          EEPROM.commit();      // Записываем из ОЗУ в EEPROM
          EEPROM.end();         // И очищаем данные из ОЗУ
        }
        ESP.restart();  // Перезагружаем ESP
        delay(2000);    // Ждём для корректной перезагрузки
      }
    }
  }
}